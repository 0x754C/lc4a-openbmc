## meta-riscv/conf/layer.conf
```bitbake
# We have a conf and classes directory, add to BBPATH
BBPATH .= ":${LAYERDIR}"

# We have a recipes-* directories, add to BBFILES
BBFILES += "${LAYERDIR}/recipes-*/*/*.bb \
	${LAYERDIR}/recipes-*/*/*.bbappend"

BBFILE_COLLECTIONS += "riscv-layer"
BBFILE_PATTERN_riscv-layer = "^${LAYERDIR}/"
BBFILE_PRIORITY_riscv-layer = "6"

BBFILES_DYNAMIC += " \
    openembedded-layer:${LAYERDIR}/dynamic-layers/openembedded-layer/*/*/*.bb \
    openembedded-layer:${LAYERDIR}/dynamic-layers/openembedded-layer/*/*/*.bbappend \
    meta-python:${LAYERDIR}/dynamic-layers/meta-python/*/*/*.bb \
    meta-python:${LAYERDIR}/dynamic-layers/meta-python/*/*/*.bbappend \
    \
"

LAYERSERIES_COMPAT_riscv-layer = "mickledore"
```

## meta-riscv/conf/machine/licheepi-rv.conf
```bitbake
#@TYPE: Machine
#@NAME: licheepi-rv
#@SOC: Allwinner D1
#@DESCRIPTION: Machine configuration for licheepi rv board

require conf/machine/include/riscv/tune-riscv.inc

MACHINE_FEATURES = "ext4 serial"

KERNEL_CLASSES = "kernel-fitimage"
KERNEL_IMAGETYPE = "fitImage"
UBOOT_ENV ?= "boot"
UBOOT_ENV_SUFFIX = "scr.uimg"
PREFERRED_PROVIDER_virtual/kernel ?= "linux-allwinnerd1-dev"
PREFERRED_PROVIDER_virtual/bootloader ?= "u-boot-allwinnerd1"

PREFERRED_VERSION_openocd-native = "riscv"
PREFERRED_VERSION_openocd = "riscv"

EXTRA_IMAGEDEPENDS += "opensbi"
RISCV_SBI_PLAT = "generic"

## This sets u-boot as the default OpenSBI payload
### Nezha board uses TOC1 images loaded by SPL and containing U-Boot, DTB, and
### OpenSBI so 'RISCV_SBI_PAYLOAD' isn't used.
### 'RISCV_SBI_FDT' isn't used because the DTB is loaded from RAM at
### ${fdtcontroladdr}
#RISCV_SBI_PAYLOAD ?= "u-boot.bin"
#RISCV_SBI_FDT ?= "sun20i-d1-nezha.dtb"

SERIAL_CONSOLES ?= "115200;ttyS0;"

MACHINE_EXTRA_RRECOMMENDS += " kernel-modules"

FLASH_SIZE ?= "16777216"

IMAGE_FSTYPES += "wic.gz wic.bmap ext4"

### 'KERNEL_DEVICETREE' isn't used because the DTB is loaded from RAM
### at address ${fdtcontroladdr}
#KERNEL_DEVICETREE ?= "allwinner/sun20i-d1-nezha.dtb"

## Do not update fstab file when using wic images
WIC_CREATE_EXTRA_ARGS ?= "--no-fstab-update"

EXTRA_IMAGEDEPENDS += "u-boot-allwinnerd1"


UBOOT_ENTRYPOINT = "0x40200000"
UBOOT_DTB_LOADADDRESS = "0x4FA00000"
UBOOT_DTB = "1"
UBOOT_DTB_BINARY ?= "sun20i-d1-lichee-rv-bmc.dtb"

## wic default support
WKS_FILE_DEPENDS ?= " \
    u-boot-allwinnerd1 \
    opensbi \
    e2fsprogs-native \
    bmap-tools-native \
"

IMAGE_BOOT_FILES ?= " \
    ${KERNEL_IMAGETYPE} \
    boot.scr.uimg \
    uEnv.txt \
"

WKS_FILE ?= "nezha.wks"
KBUILD_DEFCONFIG = "licheepi_rv_bmc_defconfig"
UBOOT_MACHINE = "licheepi_rv_bmc_defconfig"

OBMC_COMPATIBLE_NAMES = "com.sipeed.Hardware.BMC.Model.LicheepiRV"

IMAGE_FEATURES:remove = "obmc-bmcweb"
IMAGE_FEATURES:remove = "obmc-bmc-state-mgmt"
IMAGE_FEATURES:remove = "obmc-chassis-mgmt"
IMAGE_FEATURES:remove = "obmc-chassis-state-mgmt"
IMAGE_FEATURES:remove = "obmc-fan-control"
IMAGE_FEATURES:remove = "obmc-fan-mgmt"
IMAGE_FEATURES:remove = "obmc-flash-mgmt"
IMAGE_FEATURES:remove = "obmc-fru-ipmi"
IMAGE_FEATURES:remove = "obmc-health-monitor"
IMAGE_FEATURES:remove = "obmc-host-ipmi"
IMAGE_FEATURES:remove = "obmc-host-state-mgmt"
IMAGE_FEATURES:remove = "obmc-ikvm"
IMAGE_FEATURES:remove = "obmc-inventory"
IMAGE_FEATURES:remove = "obmc-leds"
IMAGE_FEATURES:remove = "obmc-net-ipmi"
IMAGE_FEATURES:remove = "obmc-sensors"
IMAGE_FEATURES:remove = "obmc-software"
IMAGE_FEATURES:remove = "obmc-telemetry"
IMAGE_FEATURES:remove = "obmc-user-mgmt-ldap"
IMAGE_FEATURES:remove = "obmc-dmtf-pmci"
```

## meta-riscv/recipes-bsp/u-boot/u-boot-allwinnerd1/licheepi_rv_bmc_defconfig
```kconfig
CONFIG_RISCV=y
CONFIG_DEFAULT_DEVICE_TREE="sun20i-d1-lichee-rv-bmc"
CONFIG_OF_LIST="sun20i-d1-lichee-rv-bmc"
CONFIG_TARGET_SUN20I_D1=y
CONFIG_ARCH_RV64I=y
CONFIG_RISCV_SMODE=y
# CONFIG_SPL_SMP is not set
CONFIG_SYS_SPL_MALLOC=y
CONFIG_SPL_OPENSBI_SCRATCH_OPTIONS=0x0
# CONFIG_SYS_I2C_MVTWSI is not set
CONFIG_NET=y
CONFIG_NET_RANDOM_ETHADDR=y
CONFIG_PHY_REALTEK=y
CONFIG_SUN8I_EMAC=y
# this usb driver is buggy, it will cause bootup, disable it.
# CONFIG_USB_EHCI_HCD is not set
# CONFIG_USB_OHCI_HCD is not set
# CONFIG_PREBOOT is not set
CONFIG_DM_REGULATOR_FIXED=y
```

## meta-riscv/recipes-kernel/linux/linux-allwinnerd1-dev/licheepi_rv_bmc_defconfig
```kconfig
# CONFIG_LOCALVERSION_AUTO is not set
CONFIG_NO_HZ_IDLE=y
CONFIG_HIGH_RES_TIMERS=y
CONFIG_PREEMPT=y
CONFIG_EXPERT=y
CONFIG_PERF_EVENTS=y
CONFIG_ARCH_SUNXI=y
CONFIG_RISCV_SBI_V01=y
CONFIG_PM=y
CONFIG_CPU_IDLE=y
CONFIG_RISCV_SBI_CPUIDLE=y
CONFIG_JUMP_LABEL=y
CONFIG_CGROUPS=y
CONFIG_NAMESPACES=y
CONFIG_EMBEDDED=y

# CONFIG_MODULES is not set
# CONFIG_MODULE_UNLOAD is not set

ONFIG_BINFMT_ELF=y
CONFIG_BINFMT_SCRIPT=y
CONFIG_COREDUMP=y

CONFIG_NET=y
CONFIG_PACKET=y
CONFIG_UNIX=y
CONFIG_INET=y
CONFIG_ETHTOOL_NETLINK=y
CONFIG_IPV6=y
# CONFIG_IPV6_SIT is not set 

CONFIG_DEVTMPFS=y
CONFIG_DEVTMPFS_MOUNT=y
CONFIG_TMPFS=y

CONFIG_NETDEVICES=y
# CONFIG_BONDING is not set
# CONFIG_DUMMY is not set
# CONFIG_TUN is not set
# CONFIG_NET_IPGRE_DEMUX is not set
# CONFIG_OPENVSWITCH is not set
CONFIG_WIREGUARD=y
CONFIG_STMMAC_ETH=y
CONFIG_STMMAC_PLATFORM=y
CONFIG_DWMAC_GENERIC=y
CONFIG_DWMAC_SUNXI=y
CONFIG_DWMAC_SUN8I=y
CONFIG_PHYLIB=y
CONFIG_REALTEK_PHY=y
CONFIG_MDIO_DEVICE=y

CONFIG_SERIAL_8250=y
# CONFIG_SERIAL_8250_DEPRECATED_OPTIONS is not set
CONFIG_SERIAL_8250_CONSOLE=y
CONFIG_SERIAL_8250_NR_UARTS=6
CONFIG_SERIAL_8250_RUNTIME_UARTS=6
CONFIG_SERIAL_8250_DW=y
CONFIG_SERIAL_OF_PLATFORM=y
CONFIG_SERIAL_EARLYCON_RISCV_SBI=y
# CONFIG_HVC_RISCV_SBI is not set

CONFIG_PINCTRL=y
CONFIG_PINCTRL_AXP209=y
CONFIG_GPIO_SYSFS=y
CONFIG_GPIO_PCF857X=y

CONFIG_THERMAL=y
CONFIG_THERMAL_STATISTICS=y
CONFIG_THERMAL_WRITABLE_TRIPS=y
CONFIG_THERMAL_GOV_BANG_BANG=y
CONFIG_THERMAL_GOV_USER_SPACE=y
CONFIG_CPU_THERMAL=y
CONFIG_THERMAL_EMULATION=y
CONFIG_SUN8I_THERMAL=y

CONFIG_WATCHDOG=y
CONFIG_WATCHDOG_CORE=y
CONFIG_WATCHDOG_SYSFS=y
CONFIG_WATCHDOG_PRETIMEOUT_GOV=y
CONFIG_WATCHDOG_PRETIMEOUT_GOV_NOOP=y
CONFIG_WATCHDOG_PRETIMEOUT_GOV_PANIC=y
CONFIG_SUNXI_WATCHDOG=y
# CONFIG_SOFT_WATCHDOG is not set

CONFIG_REGULATOR=y
CONFIG_REGULATOR_FIXED_VOLTAGE=y
CONFIG_REGULATOR_PWM=y

CONFIG_POWER_SUPPLY=y
CONFIG_PHY_SUN4I_USB=y
CONFIG_USB_SUPPORT=y
CONFIG_USB=y
CONFIG_USB_ANNOUNCE_NEW_DEVICES=y
CONFIG_USB_DYNAMIC_MINORS=y
CONFIG_USB_EHCI_HCD=y
CONFIG_USB_EHCI_HCD_PLATFORM=y
CONFIG_USB_OHCI_HCD=y
CONFIG_USB_OHCI_HCD_PLATFORM=y
CONFIG_USB_MUSB_HDRC=y
CONFIG_USB_MUSB_SUNXI=y
CONFIG_MUSB_PIO_ONLY=y
CONFIG_SCSI=y
CONFIG_BLK_DEV_SD=y
CONFIG_USB_STORAGE=y
CONFIG_USB_UAS=y
CONFIG_USB_SERIAL=y
CONFIG_USB_SERIAL_GENERIC=y
CONFIG_USB_SERIAL_SIMPLE=y
CONFIG_USB_SERIAL_FTDI_SIO=y
CONFIG_USB_ACM=y
CONFIG_NOP_USB_XCEIV=y

CONFIG_NEW_LEDS=y
CONFIG_LEDS_CLASS=y
CONFIG_LEDS_CLASS_FLASH=y
CONFIG_LEDS_GPIO=y
CONFIG_LEDS_TRIGGERS=y
CONFIG_LEDS_TRIGGER_HEARTBEAT=y
CONFIG_LEDS_TRIGGER_DEFAULT_ON=y

CONFIG_BLOCK=y
CONFIG_PARTITION_ADVANCED=y
CONFIG_MSDOS_PARTITION=y
CONFIG_EFI_PARTITION=y
CONFIG_MMC=y
CONFIG_MMC_BLOCK=y
CONFIG_MMC_SUNXI=y

CONFIG_I2C=y
CONFIG_I2C_CHARDEV=y
CONFIG_I2C_MV64XXX=y

CONFIG_RTC_CLASS=y
CONFIG_RTC_DRV_HYM8563=y
CONFIG_RTC_HCTOSYS=y
CONFIG_RTC_SYSTOHC=y
CONFIG_RTC_INTF_DEV=y
CONFIG_RTC_INTF_SYSFS=y

CONFIG_DMADEVICES=y
CONFIG_DMA_SUN6I=y

CONFIG_NVMEM_SUNXI_SID=y

CONFIG_EXT4_FS=y
CONFIG_FAT_FS=y
CONFIG_VFAT_FS=y
CONFIG_FAT_DEFAULT_CODEPAGE=437
CONFIG_FAT_DEFAULT_IOCHARSET="iso8859-1"
CONFIG_FAT_DEFAULT_UTF8=y

CONFIG_PRINTK_TIME=y
CONFIG_DEBUG_FS=y
CONFIG_DEBUG_FS_ALLOW_ALL=y

CONFIG_PANIC_TIMEOUT=5
```
